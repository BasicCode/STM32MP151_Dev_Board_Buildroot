## Config.in
```kconfig
# ESP8089 WiFi Chipset
source "$BR2_EXTERNAL_STM32MP151_Dev_Board_Buildroot_PATH/package/esp8089/Config.in"

# esp-hosted-ng
source "$BR2_EXTERNAL_STM32MP151_Dev_Board_Buildroot_PATH/package/esp-hosted-ng/Config.in"
```

## configs/stm32mp151_dev_board_defconfig
```kconfig
BR2_arm=y
BR2_cortex_a7=y
BR2_TOOLCHAIN_BUILDROOT_UCLIBC=y
BR2_TOOLCHAIN_BUILDROOT_WCHAR=y
BR2_TOOLCHAIN_BUILDROOT_CXX=y
BR2_ROOTFS_DEVICE_CREATION_DYNAMIC_EUDEV=y
BR2_ROOTFS_OVERLAY="$(BR2_EXTERNAL_STM32MP15x_Dev_Board_PATH)/board/stm32mp15x_dev_board/overlay/"
BR2_ROOTFS_POST_IMAGE_SCRIPT="$(BR2_EXTERNAL_STM32MP15x_Dev_Board_PATH)/board/stm32mp15x_dev_board/common/stm32mp157/post-image.sh"
BR2_LINUX_KERNEL=y
BR2_LINUX_KERNEL_LATEST_CIP_VERSION=y
BR2_LINUX_KERNEL_USE_CUSTOM_CONFIG=y
BR2_LINUX_KERNEL_CUSTOM_CONFIG_FILE="$(BR2_EXTERNAL_STM32MP15x_Dev_Board_PATH)/board/stm32mp15x_dev_board/linux.config"
BR2_LINUX_KERNEL_DTS_SUPPORT=y
BR2_LINUX_KERNEL_CUSTOM_DTS_PATH="$(BR2_EXTERNAL_STM32MP15x_Dev_Board_PATH)/board/stm32mp15x_dev_board/stm32mp151_dev_board.dts $(BR2_EXTERNAL_STM32MP15x_Dev_Board_PATH)/board/stm32mp15x_dev_board/stm32mp151_dev_board.dtsi"
BR2_LINUX_KERNEL_DTB_OVERLAY_SUPPORT=y
BR2_LINUX_KERNEL_INSTALL_TARGET=y
BR2_PACKAGE_ALSA_UTILS=y
BR2_PACKAGE_ALSA_UTILS_ALSACONF=y
BR2_PACKAGE_ALSA_UTILS_ACONNECT=y
BR2_PACKAGE_ALSA_UTILS_AMIXER=y
BR2_PACKAGE_ALSA_UTILS_APLAY=y
BR2_PACKAGE_ALSA_UTILS_SPEAKER_TEST=y
BR2_PACKAGE_DHRYSTONE=y
BR2_PACKAGE_FLEX=y
BR2_PACKAGE_MAKE=y
BR2_PACKAGE_DOSFSTOOLS=y
BR2_PACKAGE_EXFAT=y
BR2_PACKAGE_EXFAT_UTILS=y
BR2_PACKAGE_EXFATPROGS=y
BR2_PACKAGE_FONT_AWESOME=y
BR2_PACKAGE_LIBERATION=y
BR2_PACKAGE_CHOCOLATE_DOOM=y
BR2_PACKAGE_DOOM_WAD=y
BR2_PACKAGE_PRBOOM=y
BR2_PACKAGE_LIBVA_UTILS=y
BR2_PACKAGE_DIRECTFB=y
BR2_PACKAGE_DIRECTFB_MULTI=y
BR2_PACKAGE_FBV=y
BR2_PACKAGE_IMAGEMAGICK=y
BR2_PACKAGE_LIBGLVND=y
BR2_PACKAGE_MESA3D=y
BR2_PACKAGE_MESA3D_LLVM=y
BR2_PACKAGE_MESA3D_OSMESA_GALLIUM=y
BR2_PACKAGE_MESA3D_OPENGL_EGL=y
BR2_PACKAGE_MESA3D_OPENGL_ES=y
BR2_PACKAGE_SDL_DIRECTFB=y
BR2_PACKAGE_SDL_X11=y
BR2_PACKAGE_SDL_GFX=y
BR2_PACKAGE_SDL_IMAGE=y
BR2_PACKAGE_SDL_IMAGE_GIF=y
BR2_PACKAGE_SDL_IMAGE_JPEG=y
BR2_PACKAGE_SDL_IMAGE_PNG=y
BR2_PACKAGE_SDL_MIXER_MIDI_TIMIDITY=y
BR2_PACKAGE_SDL_SOUND=y
BR2_PACKAGE_SDL_SOUND_PLAYSOUND=y
BR2_PACKAGE_SDL_TTF=y
BR2_PACKAGE_SDL2_DIRECTFB=y
BR2_PACKAGE_SDL2_X11=y
BR2_PACKAGE_SDL2_KMSDRM=y
BR2_PACKAGE_SDL2_OPENGLES=y
BR2_PACKAGE_SDL2_GFX=y
BR2_PACKAGE_SDL2_IMAGE=y
BR2_PACKAGE_SDL2_TTF=y
BR2_PACKAGE_TK=y
BR2_PACKAGE_VULKAN_HEADERS=y
BR2_PACKAGE_WESTON=y
BR2_PACKAGE_WESTON_WAYLAND=y
BR2_PACKAGE_WESTON_X11=y
BR2_PACKAGE_XORG7=y
BR2_PACKAGE_XSERVER_XORG_SERVER=y
BR2_PACKAGE_XSERVER_XORG_SERVER_XVFB=y
BR2_PACKAGE_XSERVER_XORG_SERVER_XEPHYR=y
BR2_PACKAGE_XCB_UTIL_CURSOR=y
BR2_PACKAGE_XCB_UTIL_KEYSYMS=y
BR2_PACKAGE_XCB_UTIL_WM=y
BR2_PACKAGE_XLIB_LIBXSCRNSAVER=y
BR2_PACKAGE_XLIB_LIBXFONT=y
BR2_PACKAGE_XAPP_XCLOCK=y
BR2_PACKAGE_XAPP_XCOMPMGR=y
BR2_PACKAGE_XAPP_XCONSOLE=y
BR2_PACKAGE_XAPP_XINIT=y
BR2_PACKAGE_XAPP_XINPUT=y
BR2_PACKAGE_XAPP_XKILL=y
BR2_PACKAGE_XAPP_XLOAD=y
BR2_PACKAGE_XAPP_XLOGO=y
BR2_PACKAGE_XAPP_XLSCLIENTS=y
BR2_PACKAGE_XAPP_XLSFONTS=y
BR2_PACKAGE_XAPP_XRANDR=y
BR2_PACKAGE_XDRIVER_XF86_INPUT_EVDEV=y
BR2_PACKAGE_XDRIVER_XF86_INPUT_LIBINPUT=y
BR2_PACKAGE_XDRIVER_XF86_INPUT_MOUSE=y
BR2_PACKAGE_XDRIVER_XF86_INPUT_SYNAPTICS=y
BR2_PACKAGE_XDRIVER_XF86_INPUT_TSLIB=y
BR2_PACKAGE_XDRIVER_XF86_VIDEO_FBDEV=y
BR2_PACKAGE_XDRIVER_XF86_VIDEO_FBTURBO=y
BR2_PACKAGE_XDRIVER_XF86_VIDEO_VESA=y
BR2_PACKAGE_XTERM=y
BR2_PACKAGE_FLUXBOX=y
BR2_PACKAGE_DBUS=y
BR2_PACKAGE_EVTEST=y
BR2_PACKAGE_USBMOUNT=y
BR2_PACKAGE_USBUTILS=y
BR2_PACKAGE_LIBB2=y
BR2_PACKAGE_LIBGCRYPT=y
BR2_PACKAGE_LIBSHA1=y
BR2_PACKAGE_OPENSSL=y
BR2_PACKAGE_LEVELDB=y
BR2_PACKAGE_ATK=y
BR2_PACKAGE_GDK_PIXBUF=y
BR2_PACKAGE_HARFBUZZ=y
BR2_PACKAGE_OPENJPEG=y
BR2_PACKAGE_WAYLAND_UTILS=y
BR2_PACKAGE_WEBP=y
BR2_PACKAGE_WEBP_DEMUX=y
BR2_PACKAGE_WOFF2=y
BR2_PACKAGE_WPEBACKEND_FDO=y
BR2_PACKAGE_DTC=y
BR2_PACKAGE_DTC_PROGRAMS=y
BR2_PACKAGE_LIBGUDEV=y
BR2_PACKAGE_LIBXSLT=y
BR2_PACKAGE_LIBOPENH264=y
BR2_PACKAGE_LIBSOUP=y
BR2_PACKAGE_DOUBLE_CONVERSION=y
BR2_PACKAGE_LIBEXECINFO=y
BR2_PACKAGE_LIBTASN1=y
BR2_PACKAGE_ICU=y
BR2_PACKAGE_LIBFRIBIDI=y
BR2_PACKAGE_NCURSES_WCHAR=y
BR2_PACKAGE_NCURSES_TARGET_PROGS=y
BR2_PACKAGE_PCRE2=y
BR2_PACKAGE_PCRE2_16=y
BR2_PACKAGE_WPA_SUPPLICANT=y
BR2_PACKAGE_WPA_SUPPLICANT_AUTOSCAN=y
BR2_PACKAGE_WPA_SUPPLICANT_CLI=y
BR2_PACKAGE_WPA_SUPPLICANT_WPA_CLIENT_SO=y
BR2_PACKAGE_WPA_SUPPLICANT_PASSPHRASE=y
BR2_PACKAGE_DAEMON=y
BR2_PACKAGE_SEATD=y
BR2_PACKAGE_UTIL_LINUX_FSCK=y
BR2_PACKAGE_NANO=y
BR2_TARGET_ROOTFS_EXT2=y
BR2_TARGET_ROOTFS_EXT2_4=y
BR2_TARGET_ROOTFS_EXT2_SIZE="512M"
# BR2_TARGET_ROOTFS_TAR is not set
BR2_TARGET_ARM_TRUSTED_FIRMWARE=y
BR2_TARGET_ARM_TRUSTED_FIRMWARE_PLATFORM="stm32mp1"
BR2_TARGET_ARM_TRUSTED_FIRMWARE_CUSTOM_DTS_PATH="$(BR2_EXTERNAL_STM32MP15x_Dev_Board_PATH)/board/stm32mp15x_dev_board/stm32mp151_dev_board-tf-a.dts $(BR2_EXTERNAL_STM32MP15x_Dev_Board_PATH)/board/stm32mp15x_dev_board/stm32mp151_dev_board-tf-a-fw-config.dts $(BR2_EXTERNAL_STM32MP15x_Dev_Board_PATH)/board/stm32mp15x_dev_board/stm32mp151_dev_board-tf-a.dtsi"
BR2_TARGET_ARM_TRUSTED_FIRMWARE_UBOOT_AS_BL33=y
BR2_TARGET_ARM_TRUSTED_FIRMWARE_ADDITIONAL_VARIABLES="STM32MP_SDMMC=1 AARCH32_SP=sp_min DTB_FILE_NAME=stm32mp151_dev_board-tf-a.dtb"
BR2_TARGET_ARM_TRUSTED_FIRMWARE_DEBUG=y
BR2_TARGET_ARM_TRUSTED_FIRMWARE_NEEDS_DTC=y
BR2_TARGET_UBOOT=y
BR2_TARGET_UBOOT_BUILD_SYSTEM_KCONFIG=y
BR2_TARGET_UBOOT_CUSTOM_VERSION=y
BR2_TARGET_UBOOT_CUSTOM_VERSION_VALUE="2023.04"
BR2_TARGET_UBOOT_BOARD_DEFCONFIG="stm32mp151_dev_board_uboot"
BR2_TARGET_UBOOT_NEEDS_OPENSSL=y
BR2_TARGET_UBOOT_CUSTOM_DTS_PATH="$(BR2_EXTERNAL_STM32MP15x_Dev_Board_PATH)/board/stm32mp15x_dev_board/stm32mp151_dev_board.dtsi $(BR2_EXTERNAL_STM32MP15x_Dev_Board_PATH)/board/stm32mp15x_dev_board/stm32mp151_dev_board.dts $(BR2_EXTERNAL_STM32MP15x_Dev_Board_PATH)/board/stm32mp15x_dev_board/stm32mp151_dev_board-u-boot.dtsi"
BR2_PACKAGE_HOST_GENIMAGE=y
BR2_PACKAGE_HOST_UBOOT_TOOLS=y
```

## configs/stm32mp15x_dev_board_defconfig
```kconfig
BR2_arm=y
BR2_cortex_a7=y
BR2_TOOLCHAIN_BUILDROOT_UCLIBC=y
BR2_TOOLCHAIN_BUILDROOT_LOCALE=y
BR2_TOOLCHAIN_BUILDROOT_CXX=y
BR2_ROOTFS_DEVICE_CREATION_DYNAMIC_EUDEV=y
BR2_ROOTFS_OVERLAY="board/stm32mp15x_dev_board/overlay/"
BR2_ROOTFS_POST_IMAGE_SCRIPT="board/stm32mp15x_dev_board/common/stm32mp157/post-image.sh"
BR2_LINUX_KERNEL=y
BR2_LINUX_KERNEL_LATEST_CIP_VERSION=y
BR2_LINUX_KERNEL_USE_CUSTOM_CONFIG=y
BR2_LINUX_KERNEL_CUSTOM_CONFIG_FILE="board/stm32mp15x_dev_board/linux.config"
BR2_LINUX_KERNEL_DTS_SUPPORT=y
BR2_LINUX_KERNEL_INTREE_DTS_NAME="stm32mp157c_dev_board"
BR2_LINUX_KERNEL_DTB_OVERLAY_SUPPORT=y
BR2_LINUX_KERNEL_INSTALL_TARGET=y
BR2_PACKAGE_ALSA_UTILS=y
BR2_PACKAGE_ALSA_UTILS_ALSACONF=y
BR2_PACKAGE_ALSA_UTILS_ACONNECT=y
BR2_PACKAGE_ALSA_UTILS_AMIXER=y
BR2_PACKAGE_ALSA_UTILS_APLAY=y
BR2_PACKAGE_ALSA_UTILS_SPEAKER_TEST=y
BR2_PACKAGE_GSTREAMER1=y
BR2_PACKAGE_GST1_PLUGINS_BASE=y
BR2_PACKAGE_VLC=y
BR2_PACKAGE_DHRYSTONE=y
BR2_PACKAGE_FLEX=y
BR2_PACKAGE_MAKE=y
BR2_PACKAGE_DOSFSTOOLS=y
BR2_PACKAGE_EXFAT=y
BR2_PACKAGE_EXFAT_UTILS=y
BR2_PACKAGE_EXFATPROGS=y
BR2_PACKAGE_FONT_AWESOME=y
BR2_PACKAGE_LIBERATION=y
BR2_PACKAGE_CHOCOLATE_DOOM=y
BR2_PACKAGE_DOOM_WAD=y
BR2_PACKAGE_DIRECTFB=y
BR2_PACKAGE_DIRECTFB_MULTI=y
BR2_PACKAGE_FBV=y
BR2_PACKAGE_IMAGEMAGICK=y
BR2_PACKAGE_LIBGLVND=y
BR2_PACKAGE_MESA3D=y
BR2_PACKAGE_MESA3D_LLVM=y
BR2_PACKAGE_MESA3D_OSMESA_GALLIUM=y
BR2_PACKAGE_MESA3D_OPENGL_GLX=y
BR2_PACKAGE_MESA3D_OPENGL_EGL=y
BR2_PACKAGE_MESA3D_OPENGL_ES=y
BR2_PACKAGE_SDL2_DIRECTFB=y
BR2_PACKAGE_SDL2_KMSDRM=y
BR2_PACKAGE_SDL2_OPENGL=y
BR2_PACKAGE_SDL2_OPENGLES=y
BR2_PACKAGE_SDL2_GFX=y
BR2_PACKAGE_SDL2_IMAGE=y
BR2_PACKAGE_VULKAN_HEADERS=y
BR2_PACKAGE_QT6=y
BR2_PACKAGE_QT6BASE_CONCURRENT=y
BR2_PACKAGE_QT6BASE_DBUS=y
BR2_PACKAGE_QT6BASE_NETWORK=y
BR2_PACKAGE_QT6BASE_SYSLOG=y
BR2_PACKAGE_QT6BASE_TEST=y
BR2_PACKAGE_QT6BASE_XML=y
BR2_PACKAGE_QT6SERIALPORT=y
BR2_PACKAGE_XORG7=y
BR2_PACKAGE_XSERVER_XORG_SERVER=y
BR2_PACKAGE_XCB_UTIL_CURSOR=y
BR2_PACKAGE_XCB_UTIL_KEYSYMS=y
BR2_PACKAGE_XCB_UTIL_WM=y
BR2_PACKAGE_XLIB_LIBFS=y
BR2_PACKAGE_XLIB_LIBXCOMPOSITE=y
BR2_PACKAGE_XLIB_LIBXFONT=y
BR2_PACKAGE_XLIB_LIBXTST=y
BR2_PACKAGE_XAPP_TWM=y
BR2_PACKAGE_XAPP_XCALC=y
BR2_PACKAGE_XAPP_XCLOCK=y
BR2_PACKAGE_XAPP_XEYES=y
BR2_PACKAGE_XAPP_XINIT=y
BR2_PACKAGE_XAPP_XINPUT=y
BR2_PACKAGE_XAPP_XRANDR=y
BR2_PACKAGE_XDRIVER_XF86_INPUT_EVDEV=y
BR2_PACKAGE_XDRIVER_XF86_INPUT_KEYBOARD=y
BR2_PACKAGE_XDRIVER_XF86_INPUT_LIBINPUT=y
BR2_PACKAGE_XDRIVER_XF86_INPUT_MOUSE=y
BR2_PACKAGE_XDRIVER_XF86_INPUT_TSLIB=y
BR2_PACKAGE_XDRIVER_XF86_VIDEO_CIRRUS=y
BR2_PACKAGE_XDRIVER_XF86_VIDEO_FBDEV=y
BR2_PACKAGE_XDRIVER_XF86_VIDEO_FBTURBO=y
BR2_PACKAGE_XDRIVER_XF86_VIDEO_VESA=y
BR2_PACKAGE_ALSAMIXERGUI=y
BR2_PACKAGE_XTERM=y
BR2_PACKAGE_FLUXBOX=y
BR2_PACKAGE_EVTEST=y
BR2_PACKAGE_USBMOUNT=y
BR2_PACKAGE_USBUTILS=y
BR2_PACKAGE_LIBSHA1=y
BR2_PACKAGE_OPENSSL=y
BR2_PACKAGE_LEVELDB=y
BR2_PACKAGE_SQLITE=y
BR2_PACKAGE_ATK=y
BR2_PACKAGE_GDK_PIXBUF=y
BR2_PACKAGE_HARFBUZZ=y
BR2_PACKAGE_LIBGLEW=y
BR2_PACKAGE_LIBGLU=y
BR2_PACKAGE_WAYLAND=y
BR2_PACKAGE_WAYLAND_UTILS=y
BR2_PACKAGE_WAYLANDPP=y
BR2_PACKAGE_WEBP=y
BR2_PACKAGE_WEBP_DEMUX=y
BR2_PACKAGE_WOFF2=y
BR2_PACKAGE_DTC=y
BR2_PACKAGE_DTC_PROGRAMS=y
BR2_PACKAGE_LIBGUDEV=y
BR2_PACKAGE_LIBXKBCOMMON=y
BR2_PACKAGE_LIBXSLT=y
BR2_PACKAGE_LIBOPENH264=y
BR2_PACKAGE_LIBEXECINFO=y
BR2_PACKAGE_ICU=y
BR2_PACKAGE_LIBFRIBIDI=y
BR2_PACKAGE_NCURSES_WCHAR=y
BR2_PACKAGE_NCURSES_TARGET_PROGS=y
BR2_PACKAGE_WPA_SUPPLICANT=y
BR2_PACKAGE_WPA_SUPPLICANT_AUTOSCAN=y
BR2_PACKAGE_WPA_SUPPLICANT_CLI=y
BR2_PACKAGE_WPA_SUPPLICANT_WPA_CLIENT_SO=y
BR2_PACKAGE_WPA_SUPPLICANT_PASSPHRASE=y
BR2_PACKAGE_DAEMON=y
BR2_PACKAGE_UTIL_LINUX_FSCK=y
BR2_PACKAGE_NANO=y
BR2_TARGET_ROOTFS_EXT2=y
BR2_TARGET_ROOTFS_EXT2_4=y
BR2_TARGET_ROOTFS_EXT2_SIZE="1G"
# BR2_TARGET_ROOTFS_TAR is not set
BR2_TARGET_ARM_TRUSTED_FIRMWARE=y
BR2_TARGET_ARM_TRUSTED_FIRMWARE_CUSTOM_VERSION=y
BR2_TARGET_ARM_TRUSTED_FIRMWARE_CUSTOM_VERSION_VALUE="v2.5"
BR2_TARGET_ARM_TRUSTED_FIRMWARE_PLATFORM="stm32mp1"
BR2_TARGET_ARM_TRUSTED_FIRMWARE_ADDITIONAL_VARIABLES="STM32MP_SDMMC=1 AARCH32_SP=sp_min DTB_FILE_NAME=stm32mp157c_dev_board.dtb"
BR2_TARGET_ARM_TRUSTED_FIRMWARE_IMAGES="*.stm32"
BR2_TARGET_ARM_TRUSTED_FIRMWARE_NEEDS_DTC=y
BR2_TARGET_UBOOT=y
BR2_TARGET_UBOOT_BUILD_SYSTEM_KCONFIG=y
BR2_TARGET_UBOOT_CUSTOM_VERSION=y
BR2_TARGET_UBOOT_CUSTOM_VERSION_VALUE="2021.10"
BR2_TARGET_UBOOT_BOARD_DEFCONFIG="stm32mp15_trusted"
BR2_TARGET_UBOOT_NEEDS_OPENSSL=y
# BR2_TARGET_UBOOT_FORMAT_BIN is not set
BR2_TARGET_UBOOT_FORMAT_STM32=y
BR2_TARGET_UBOOT_CUSTOM_MAKEOPTS="DEVICE_TREE=stm32mp157c_dev_board"
BR2_PACKAGE_HOST_GENIMAGE=y
BR2_PACKAGE_HOST_UBOOT_TOOLS=y
```

## package/esp-hosted-ng/Config.in
```kconfig
config BR2_PACKAGE_ESP_HOSTED_NG
       bool "esp_hosted_ng"
       help
               esp_hosted_ng package available from (https://github.com/espressif/esp-hosted/tree/master/esp_hosted_ng).
```

## package/xyz/Config.in
```kconfig
config BR2_PACKAGE_XYZ
       bool "xyz"
       help
               This is sample package.
```
